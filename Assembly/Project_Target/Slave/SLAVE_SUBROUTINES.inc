;************************************************************************************
;										    *
;   Filename:	    SLAVE_SUBROUTINES.inc					    *
;   Date:	    April 23, 2025						    *
;   File Version:   2								    *
;   Author:	    Alex Wheelock and Andrew Keller				    *
;   Company:	    Idaho State University					    *
;   Description:    Contains all subroutines needed for the Laser Shooting Game     *
;		    target slave. Subroutines include I2C communications, recording *
;		    player hits, and enabling/disabling the target. The I2C	    *
;		    communications includes the ability to both receive data from   *
;		    the master as well as the ability to respond to read requests   *
;		    from the master. When a hit is detected, the LED is flashed.    *
;										    *
;************************************************************************************

;************************************************************************************
;										    *
;   Revision History:								    *
;										    *
;   1:	Initialize file, get everything working the way that I thought it should    *
;	work.									    *
;										    *
;   2:	  I2C communications for enabling/disabling the target as well as reporting *
;          any player hits to the target when the target is enabled.		    *
;										    *
;************************************************************************************		
	    
SUBROUTINES_CODE CODE
    
    ;RECEIVES AND INTERPRETS I2C DATA, RESPONDS TO I2C READ REQUESTS
    RECEIVE: 
	    BANKSEL	PIR1
	    BCF		PIR1, SSP1IF		;IMMEDIATELY CLEAR INTERRUPT FLAG
	    BANKSEL	SSP1BUF			;\READ BYTE FROM MASTER
	    MOVFW	SSP1BUF			;/
	    MOVWF	RECEIVED_DATA
	    BANKSEL	SSP1STAT		;DETERMINE IF THE RECEIVED BYTE WAS DATA OR ADDRESS
	    BTFSS	SSP1STAT,5		;1=DATA, 0=ADDRESS
	    GOTO	CHECK_READ_OR_WRITE	;BYTE RECEIVED WAS ADDRESS, CHECK IF R/W
	    GOTO	SAVE_DATA		;BYTE RECEIVED WAS DATA, SAVE BYTE
	    
	CHECK_READ_OR_WRITE	
	    BTFSS	SSP1STAT,2		;TEST IF ADDRESS BYTE WAS R/W: R = 1, W = 0
	    GOTO	SAVE_DATA		;MASTER WRITE: SAVE DATA
	    GOTO	TRANSMIT_STATUS		;MASTER READ: TRANSMIT THE TARGET STATUS
	
	;TESTS THE RECEIVED DATA AGAINST THE KNOWN ENABLE AND DISABLE COMMANDS
	SAVE_DATA
	    BANKSEL	PORTA
	    MOVWF	RECEIVED_DATA
	    XORLW	0X45
	    BTFSC	STATUS, Z	    ;IF RECEIVED BYTE IS ENABLE COMMAND, SET TARGET TO ACTIVE
	    GOTO	ENABLE_TARGET	    
	    MOVFW	RECEIVED_DATA
	    XORLW	0X44
	    BTFSC	STATUS, Z	    ;IF RECEIVED BYTE IS DISABLE COMMAND, SET TARGET TO INACTIVE
	    GOTO	DISABLE_TARGET
	    MOVFW	RECEIVED_DATA
	    XORLW	0X43
	    BTFSC	STATUS, Z	    ;IF RECEIVED BYTE IS DISABLE COMMAND, SET TARGET TO INACTIVE
	    GOTO	CHANGE_COLOR
	    RETURN
	    
	UART_RX
	    BANKSEL	RCREG
	    MOVFW	RCREG
	    BANKSEL	PORTA
	    MOVWF	EU_RX
	    BANKSEL	PIR1		    ;CLEAR THE INTERRUPT FLAG
	    BCF		PIR1, RCIF
	    
	    BANKSEL	PORTA
	    MOVFW	EU_RX
	    
	    XORLW	0X24
	    BTFSC	STATUS, Z	    ;IF RECEIVED BYTE IS VB HANDSHAKE, GOTO VB RECEIVE
	    GOTO	VB_RECEIVE
	    BANKSEL	PORTA
	    MOVFW	EU_RX
	    XORLW	0X3C
	    BTFSC	STATUS, Z	    ;IF RECEIVED BYTE IS BLASTER HANDSHAKE, GOTO BLASTER RECEIVE
	    GOTO	BLASTER_RECEIVE
	
	    RETURN
	    
	VB_RECEIVE
	    BANKSEL	PIR1		    ;WAIT TO RECEIVE AGAIN
	    BTFSS	PIR1, RCIF
	    GOTO	VB_RECEIVE
	    
	    
	    
	    RETURN
	    
	BLASTER_RECEIVE
	    BANKSEL	PIR1		    ;WAIT TO RECEIVE AGAIN
	    BTFSS	PIR1, RCIF
	    GOTO	$-1
	    
	    BANKSEL	RCREG
	    MOVFW	RCREG
	    BANKSEL	PORTA
	    MOVWF	PLAYER_HIT
	    BANKSEL	PIR1		    ;CLEAR THE INTERRUPT FLAG
	    BCF		PIR1, RCIF
	    
	    BANKSEL	PIR1		    ;WAIT TO RECEIVE AGAIN
	    BTFSS	PIR1, RCIF
	    GOTO	$-1
	    
	    BANKSEL	RCREG
	    MOVFW	RCREG
	    BANKSEL	PIR1		    ;CLEAR THE INTERRUPT FLAG
	    BCF		PIR1, RCIF
	    BANKSEL	PORTA
	    XORLW	0X3E
	    BTFSC	STATUS, Z	    ;IF RECEIVED BYTE IS BLASTER HANDSHAKE, GOTO HIT_RECORDED
	    GOTO	HIT_RECORDED
	    CLRF	PLAYER_HIT
	    	    
	    RETURN
	    
	HIT_RECORDED
	    CALL	DISABLE_TARGET	    ;DISABLE THE TARGET
	    
	    BANKSEL	PORTA
	    MOVFW	PLAYER_HIT
	    XORLW	0X01
	    BTFSC	STATUS, Z	    ;IF PLAYER ONE HIT THE TARGET, FLASH PLAYER ONE COLORS
	    GOTO	RECORD_PLAYER1_HIT
	    
	    MOVFW	PLAYER_HIT
	    XORLW	0X02
	    BTFSC	STATUS, Z	    ;IF PLAYER TWO HIT THE TARGET, FLASH PLAYER TWO COLORS
	    GOTO	RECORD_PLAYER2_HIT
	    
	    MOVFW	PLAYER_HIT
	    XORLW	0X03
	    BTFSC	STATUS, Z	    ;IF PLAYER THREE HIT THE TARGET, FLASH PLAYER THREE COLORS
	    GOTO	RECORD_PLAYER3_HIT
	    
	    MOVFW	PLAYER_HIT
	    XORLW	0X04
	    BTFSC	STATUS, Z	    ;IF PLAYER FOUR HIT THE TARGET, FLASH PLAYER FOUR COLORS
	    GOTO	RECORD_PLAYER4_HIT
	    
	    RETURN
	    
	ENABLE_TARGET
	    BANKSEL	PORTA
	    BSF		ACTIVE, 0
	    
	    MOVLW	0x01
	    MOVWF	_LEDNUMBER
	    MOVLW	0xFF
	    MOVWF	_SENDLEDGREEN
	    MOVLW	0x00
	    MOVWF	_SENDLEDBLUE
	    MOVLW	0x00
	    MOVWF	_SENDLEDRED
	    
	    CALL	SENDLED
	    	
	    RETURN
	    
	DISABLE_TARGET
	    BANKSEL	PORTA
	    BCF		ACTIVE, 0
	    
	    MOVLW	0x01
	    MOVWF	_LEDNUMBER
	    MOVLW	0x00
	    MOVWF	_SENDLEDGREEN
	    MOVLW	0x00
	    MOVWF	_SENDLEDBLUE
	    MOVLW	0x00
	    MOVWF	_SENDLEDRED
	    
	    CALL	SENDLED
	    	
	    RETURN
	    
	CHANGE_COLOR
	
	    RETURN
    
	;TRANSMIT THE CURRENT TARGET STATUS BACK TO THE MASTER IF A READ WAS RECEIVED
	TRANSMIT_STATUS
	    BANKSEL	PORTA
	    MOVFW	PLAYER_HIT	    ;RETREIVE THE CURRENT TARGET STATUS
	    BANKSEL	SSP1BUF
	    MOVWF	SSP1BUF		    ;MOVE THE TARGET STATUS INTO THE I2C BUFFER
	    BANKSEL	SSP1CON1
	    BSF		SSP1CON1, CKP	    ;START THE CLOCK TO BEGIN DATA TRANSMISSION
	    BANKSEL	PORTA
	    CLRF	PLAYER_HIT
	    RETURN
	    
    ;WHEN PLAYER ONE RECEIVES A HIT 
    ;FLASH THE LEDS FOR PLAYER ONE
    RECORD_PLAYER1_HIT:
	    BANKSEL	PORTB
	    MOVFW	P1_G
	    MOVWF	_SENDLEDGREEN
	    MOVFW	P1_B
	    MOVWF	_SENDLEDBLUE
	    MOVFW	P1_R
	    MOVWF	_SENDLEDRED
	    CALL	SENDLED		    ;SEND PLAYER ONE COLOR TO LEDS
	    CALL	WAIT_FOR_TMR1	    ;WAIT FOR A MOMENT
	    CALL	WAIT_FOR_TMR1
	    CALL	WAIT_FOR_TMR1
	    CALL	WAIT_FOR_TMR1
	    CLRF	_SENDLEDRED	    ;TURN OFF ALL THE LIGHTS
	    CLRF	_SENDLEDGREEN
	    CLRF	_SENDLEDBLUE
	    CALL	SENDLED		    ;SEND TO LEDS
	    CALL	WAIT_FOR_TMR1	    ;WAIT FOR A MOMENT
	    CALL	WAIT_FOR_TMR1
	    CALL	WAIT_FOR_TMR1
	    CALL	WAIT_FOR_TMR1
	    MOVFW	P1_G
	    MOVWF	_SENDLEDGREEN
	    MOVFW	P1_B
	    MOVWF	_SENDLEDBLUE
	    MOVFW	P1_R
	    MOVWF	_SENDLEDRED
	    CALL	SENDLED		    ;SEND PLAYER ONE COLOR TO LEDS
	    CALL	WAIT_FOR_TMR1	    ;WAIT FOR A MOMENT
	    CALL	WAIT_FOR_TMR1
	    CALL	WAIT_FOR_TMR1
	    CALL	WAIT_FOR_TMR1
	    CLRF	_SENDLEDRED	    ;TURN OFF ALL THE LIGHTS
	    CLRF	_SENDLEDGREEN
	    CLRF	_SENDLEDBLUE
	    CALL	SENDLED		    ;SEND TO LEDS
	    CALL	WAIT_FOR_TMR1	    ;WAIT FOR A MOMENT
	    CALL	WAIT_FOR_TMR1
	    CALL	WAIT_FOR_TMR1
	    CALL	WAIT_FOR_TMR1
	    MOVFW	P1_G
	    MOVWF	_SENDLEDGREEN
	    MOVFW	P1_B
	    MOVWF	_SENDLEDBLUE
	    MOVFW	P1_R
	    MOVWF	_SENDLEDRED
	    CALL	SENDLED		    ;SEND PLAYER ONE COLOR TO LEDS
	    CALL	WAIT_FOR_TMR1	    ;WAIT FOR A MOMENT
	    CALL	WAIT_FOR_TMR1
	    CALL	WAIT_FOR_TMR1
	    CALL	WAIT_FOR_TMR1
	    CLRF	_SENDLEDRED	    ;TURN OFF ALL THE LIGHTS
	    CLRF	_SENDLEDGREEN
	    CLRF	_SENDLEDBLUE
	    CALL	SENDLED		    ;SEND TO LEDS
	    RETURN
	    
    ;WHEN PLAYER TWO RECEIVES A HIT 
    ;FLASH THE LEDS FOR PLAYER TWO
    RECORD_PLAYER2_HIT:
	    BANKSEL	PORTB
	    MOVFW	P2_G
	    MOVWF	_SENDLEDGREEN
	    MOVFW	P2_B
	    MOVWF	_SENDLEDBLUE
	    MOVFW	P2_R
	    MOVWF	_SENDLEDRED
	    CALL	SENDLED		    ;SEND PLAYER TWO COLOR TO LEDS
	    CALL	WAIT_FOR_TMR1	    ;WAIT FOR A MOMENT
	    CALL	WAIT_FOR_TMR1
	    CALL	WAIT_FOR_TMR1
	    CALL	WAIT_FOR_TMR1
	    CLRF	_SENDLEDRED	    ;TURN OFF ALL THE LIGHTS
	    CLRF	_SENDLEDGREEN
	    CLRF	_SENDLEDBLUE
	    CALL	SENDLED		    ;SEND TO LEDS
	    CALL	WAIT_FOR_TMR1	    ;WAIT FOR A MOMENT
	    CALL	WAIT_FOR_TMR1
	    CALL	WAIT_FOR_TMR1
	    CALL	WAIT_FOR_TMR1
	    MOVFW	P2_G
	    MOVWF	_SENDLEDGREEN
	    MOVFW	P2_B
	    MOVWF	_SENDLEDBLUE
	    MOVFW	P2_R
	    MOVWF	_SENDLEDRED
	    CALL	SENDLED		    ;SEND PLAYER TWO COLOR TO LEDS
	    CALL	WAIT_FOR_TMR1	    ;WAIT FOR A MOMENT
	    CALL	WAIT_FOR_TMR1
	    CALL	WAIT_FOR_TMR1
	    CALL	WAIT_FOR_TMR1
	    CLRF	_SENDLEDRED	    ;TURN OFF ALL THE LIGHTS
	    CLRF	_SENDLEDGREEN
	    CLRF	_SENDLEDBLUE
	    CALL	SENDLED		    ;SEND TO LEDS
	    CALL	WAIT_FOR_TMR1	    ;WAIT FOR A MOMENT
	    CALL	WAIT_FOR_TMR1
	    CALL	WAIT_FOR_TMR1
	    CALL	WAIT_FOR_TMR1
	    MOVFW	P2_G
	    MOVWF	_SENDLEDGREEN
	    MOVFW	P2_B
	    MOVWF	_SENDLEDBLUE
	    MOVFW	P2_R
	    MOVWF	_SENDLEDRED
	    CALL	SENDLED		    ;SEND PLAYER TWO COLOR TO LEDS
	    CALL	WAIT_FOR_TMR1	    ;WAIT FOR A MOMENT
	    CALL	WAIT_FOR_TMR1
	    CALL	WAIT_FOR_TMR1
	    CALL	WAIT_FOR_TMR1
	    CLRF	_SENDLEDRED	    ;TURN OFF ALL THE LIGHTS
	    CLRF	_SENDLEDGREEN
	    CLRF	_SENDLEDBLUE
	    CALL	SENDLED		    ;SEND TO LEDS
	    RETURN
	    
    ;WHEN PLAYER THREE RECEIVES A HIT 
    ;FLASH THE LEDS FOR PLAYER THREE
    RECORD_PLAYER3_HIT:
	    BANKSEL	PORTB
	    MOVFW	P3_G
	    MOVWF	_SENDLEDGREEN
	    MOVFW	P3_B
	    MOVWF	_SENDLEDBLUE
	    MOVFW	P3_R
	    MOVWF	_SENDLEDRED
	    CALL	SENDLED		    ;SEND PLAYER THREE COLOR TO LEDS
	    CALL	WAIT_FOR_TMR1	    ;WAIT FOR A MOMENT
	    CALL	WAIT_FOR_TMR1
	    CALL	WAIT_FOR_TMR1
	    CALL	WAIT_FOR_TMR1
	    CLRF	_SENDLEDRED	    ;TURN OFF ALL THE LIGHTS
	    CLRF	_SENDLEDGREEN
	    CLRF	_SENDLEDBLUE
	    CALL	SENDLED		    ;SEND TO LEDS
	    CALL	WAIT_FOR_TMR1	    ;WAIT FOR A MOMENT
	    CALL	WAIT_FOR_TMR1
	    CALL	WAIT_FOR_TMR1
	    CALL	WAIT_FOR_TMR1
	    MOVFW	P3_G
	    MOVWF	_SENDLEDGREEN
	    MOVFW	P3_B
	    MOVWF	_SENDLEDBLUE
	    MOVFW	P3_R
	    MOVWF	_SENDLEDRED
	    CALL	SENDLED		    ;SEND PLAYER THREE COLOR TO LEDS
	    CALL	WAIT_FOR_TMR1	    ;WAIT FOR A MOMENT
	    CALL	WAIT_FOR_TMR1
	    CALL	WAIT_FOR_TMR1
	    CALL	WAIT_FOR_TMR1
	    CLRF	_SENDLEDRED	    ;TURN OFF ALL THE LIGHTS
	    CLRF	_SENDLEDGREEN
	    CLRF	_SENDLEDBLUE
	    CALL	SENDLED		    ;SEND TO LEDS
	    CALL	WAIT_FOR_TMR1	    ;WAIT FOR A MOMENT
	    CALL	WAIT_FOR_TMR1
	    CALL	WAIT_FOR_TMR1
	    CALL	WAIT_FOR_TMR1
	    MOVFW	P3_G
	    MOVWF	_SENDLEDGREEN
	    MOVFW	P3_B
	    MOVWF	_SENDLEDBLUE
	    MOVFW	P3_R
	    MOVWF	_SENDLEDRED
	    CALL	SENDLED		    ;SEND PLAYER THREE COLOR TO LEDS
	    CALL	WAIT_FOR_TMR1	    ;WAIT FOR A MOMENT
	    CALL	WAIT_FOR_TMR1
	    CALL	WAIT_FOR_TMR1
	    CALL	WAIT_FOR_TMR1
	    CLRF	_SENDLEDRED	    ;TURN OFF ALL THE LIGHTS
	    CLRF	_SENDLEDGREEN
	    CLRF	_SENDLEDBLUE
	    CALL	SENDLED		    ;SEND TO LEDS
	    RETURN
	    
    ;WHEN PLAYER FOUR RECEIVES A HIT 
    ;FLASH THE LEDS FOR PLAYER FOUR
    RECORD_PLAYER4_HIT:
	    BANKSEL	PORTB
	    MOVFW	P4_G
	    MOVWF	_SENDLEDGREEN
	    MOVFW	P4_B
	    MOVWF	_SENDLEDBLUE
	    MOVFW	P4_R
	    MOVWF	_SENDLEDRED
	    CALL	SENDLED		    ;SEND PLAYER FOUR COLOR TO LEDS
	    CALL	WAIT_FOR_TMR1	    ;WAIT FOR A MOMENT
	    CALL	WAIT_FOR_TMR1
	    CALL	WAIT_FOR_TMR1
	    CALL	WAIT_FOR_TMR1
	    CLRF	_SENDLEDRED	    ;TURN OFF ALL THE LIGHTS
	    CLRF	_SENDLEDGREEN
	    CLRF	_SENDLEDBLUE
	    CALL	SENDLED		    ;SEND TO LEDS
	    CALL	WAIT_FOR_TMR1	    ;WAIT FOR A MOMENT
	    CALL	WAIT_FOR_TMR1
	    CALL	WAIT_FOR_TMR1
	    CALL	WAIT_FOR_TMR1
	    MOVFW	P4_G
	    MOVWF	_SENDLEDGREEN
	    MOVFW	P4_B
	    MOVWF	_SENDLEDBLUE
	    MOVFW	P4_R
	    MOVWF	_SENDLEDRED
	    CALL	SENDLED		    ;SEND PLAYER FOUR COLOR TO LEDS
	    CALL	WAIT_FOR_TMR1	    ;WAIT FOR A MOMENT
	    CALL	WAIT_FOR_TMR1
	    CALL	WAIT_FOR_TMR1
	    CALL	WAIT_FOR_TMR1
	    CLRF	_SENDLEDRED	    ;TURN OFF ALL THE LIGHTS
	    CLRF	_SENDLEDGREEN
	    CLRF	_SENDLEDBLUE
	    CALL	SENDLED		    ;SEND TO LEDS
	    CALL	WAIT_FOR_TMR1	    ;WAIT FOR A MOMENT
	    CALL	WAIT_FOR_TMR1
	    CALL	WAIT_FOR_TMR1
	    CALL	WAIT_FOR_TMR1
	    MOVFW	P4_G
	    MOVWF	_SENDLEDGREEN
	    MOVFW	P4_B
	    MOVWF	_SENDLEDBLUE
	    MOVFW	P4_R
	    MOVWF	_SENDLEDRED
	    CALL	SENDLED		    ;SEND PLAYER FOUR COLOR TO LEDS
	    CALL	WAIT_FOR_TMR1	    ;WAIT FOR A MOMENT
	    CALL	WAIT_FOR_TMR1
	    CALL	WAIT_FOR_TMR1
	    CALL	WAIT_FOR_TMR1
	    CLRF	_SENDLEDRED	    ;TURN OFF ALL THE LIGHTS
	    CLRF	_SENDLEDGREEN
	    CLRF	_SENDLEDBLUE
	    CALL	SENDLED		    ;SEND TO LEDS
	    RETURN
	    
    ;LOOPS UNTIL TMR1 OVERFLOW
    WAIT_FOR_TMR1:
	    BCF		PIR1,0			;CLEAR TMR1IF
	    BANKSEL	T1CON
	    BSF		T1CON,0			;ENABLE TIMER 1
	    BANKSEL	TMR1L
	    CLRF	TMR1L			;/RESET TMR1 FOR FULL TIMING
	    CLRF	TMR1H			;\
	    BCF		PIR1,0			;CLEAR TMR1IF
	    BTFSS	PIR1,0			;POLL TMR1IF UNTIL COMPLETE
	    GOTO	$-1			;TMR1 NOT DONE
	    BANKSEL	T1CON
	    BCF		T1CON,0			;DISABLE TIMER 1
	    RETURN

	    
;SEND COLORS OUT TO THE WS2812B LEDS
SENDLED:
    BANKSEL _LEDNUMBER
    MOVF _LEDNUMBER, W
    MOVWF _LEDCOUNTER

LEDLOOP:
    ;Green bit 7
    BTFSC _SENDLEDGREEN, 7
    GOTO GREENBIT7_HIGH
    NOP
    BSF PORTA, 0
    NOP
    NOP
    BCF PORTA, 0
    NOP
    GOTO GREENBIT6
GREENBIT7_HIGH:
    BSF PORTA, 0
    NOP
    NOP
    NOP
    NOP
    NOP
    BCF PORTA, 0
    
GREENBIT6:
    BTFSC _SENDLEDGREEN, 6
    GOTO GREENBIT6_HIGH
    NOP
    BSF PORTA, 0
    NOP
    NOP
    BCF PORTA, 0
    NOP
    GOTO GREENBIT5
GREENBIT6_HIGH:
    BSF PORTA, 0
    NOP
    NOP
    NOP
    NOP
    NOP
    BCF PORTA, 0
    
GREENBIT5:
    BTFSC _SENDLEDGREEN, 5
    GOTO GREENBIT5_HIGH
    NOP
    BSF PORTA, 0
    NOP
    NOP
    BCF PORTA, 0
    NOP
    GOTO GREENBIT4
GREENBIT5_HIGH:
    BSF PORTA, 0
    NOP
    NOP
    NOP
    NOP
    NOP
    BCF PORTA, 0
    
GREENBIT4:
    BTFSC _SENDLEDGREEN, 4
    GOTO GREENBIT4_HIGH
    NOP
    BSF PORTA, 0
    NOP
    NOP
    BCF PORTA, 0
    NOP
    GOTO GREENBIT3
GREENBIT4_HIGH:
    BSF PORTA, 0
    NOP
    NOP
    NOP
    NOP
    NOP
    BCF PORTA, 0
    
GREENBIT3:
    BTFSC _SENDLEDGREEN, 3
    GOTO GREENBIT3_HIGH
    NOP
    BSF PORTA, 0
    NOP
    NOP
    BCF PORTA, 0
    NOP
    GOTO GREENBIT2
GREENBIT3_HIGH:
    BSF PORTA, 0
    NOP
    NOP
    NOP
    NOP
    NOP
    BCF PORTA, 0
    
GREENBIT2:
    BTFSC _SENDLEDGREEN, 2
    GOTO GREENBIT2_HIGH
    NOP
    BSF PORTA, 0
    NOP
    NOP
    BCF PORTA, 0
    NOP
    GOTO GREENBIT1
GREENBIT2_HIGH:
    BSF PORTA, 0
    NOP
    NOP
    NOP
    NOP
    NOP
    BCF PORTA, 0
    
GREENBIT1:
    BTFSC _SENDLEDGREEN, 1
    GOTO GREENBIT1_HIGH
    NOP
    BSF PORTA, 0
    NOP
    NOP
    BCF PORTA, 0
    NOP
    GOTO GREENBIT0
GREENBIT1_HIGH:
    BSF PORTA, 0
    NOP
    NOP
    NOP
    NOP
    NOP
    BCF PORTA, 0
    
GREENBIT0:
    BTFSC _SENDLEDGREEN, 0
    GOTO GREENBIT0_HIGH
    NOP
    BSF PORTA, 0
    NOP
    NOP
    BCF PORTA, 0
    NOP
    GOTO REDBIT7
GREENBIT0_HIGH:
    BSF PORTA, 0
    NOP
    NOP
    NOP
    NOP
    NOP
    BCF PORTA, 0
    

REDBIT7:
    BTFSC _SENDLEDRED, 7
    GOTO REDBIT7_HIGH
    NOP
    BSF PORTA, 0
    NOP
    NOP
    BCF PORTA, 0
    NOP
    GOTO REDBIT6
REDBIT7_HIGH:
    BSF PORTA, 0
    NOP
    NOP
    NOP
    NOP
    NOP
    BCF PORTA, 0
    
REDBIT6:
    BTFSC _SENDLEDRED, 6
    GOTO REDBIT6_HIGH
    NOP
    BSF PORTA, 0
    NOP
    NOP
    BCF PORTA, 0
    NOP
    GOTO REDBIT5
REDBIT6_HIGH:
    BSF PORTA, 0
    NOP
    NOP
    NOP
    NOP
    NOP
    BCF PORTA, 0
    
REDBIT5:
    BTFSC _SENDLEDRED, 5
    GOTO REDBIT5_HIGH
    NOP
    BSF PORTA, 0
    NOP
    NOP
    BCF PORTA, 0
    NOP
    GOTO REDBIT4
REDBIT5_HIGH:
    BSF PORTA, 0
    NOP
    NOP
    NOP
    NOP
    NOP
    BCF PORTA, 0
    
REDBIT4:
    BTFSC _SENDLEDRED, 4
    GOTO REDBIT4_HIGH
    NOP
    BSF PORTA, 0
    NOP
    NOP
    BCF PORTA, 0
    NOP
    GOTO REDBIT3
REDBIT4_HIGH:
    BSF PORTA, 0
    NOP
    NOP
    NOP
    NOP
    NOP
    BCF PORTA, 0
    
REDBIT3:
    BTFSC _SENDLEDRED, 3
    GOTO REDBIT3_HIGH
    NOP
    BSF PORTA, 0
    NOP
    NOP
    BCF PORTA, 0
    NOP
    GOTO REDBIT2
REDBIT3_HIGH:
    BSF PORTA, 0
    NOP
    NOP
    NOP
    NOP
    NOP
    BCF PORTA, 0
    
REDBIT2:
    BTFSC _SENDLEDRED, 2
    GOTO REDBIT2_HIGH
    NOP
    BSF PORTA, 0
    NOP
    NOP
    BCF PORTA, 0
    NOP
    GOTO REDBIT1
REDBIT2_HIGH:
    BSF PORTA, 0
    NOP
    NOP
    NOP
    NOP
    NOP
    BCF PORTA, 0
    
REDBIT1:
    BTFSC _SENDLEDRED, 1
    GOTO REDBIT1_HIGH
    NOP
    BSF PORTA, 0
    NOP
    NOP
    BCF PORTA, 0
    NOP
    GOTO REDBIT0
REDBIT1_HIGH:
    BSF PORTA, 0
    NOP
    NOP
    NOP
    NOP
    NOP
    BCF PORTA, 0
    
REDBIT0:
    BTFSC _SENDLEDRED, 0
    GOTO REDBIT0_HIGH
    NOP
    BSF PORTA, 0
    NOP
    NOP
    BCF PORTA, 0
    NOP
    GOTO BLUEBIT7
REDBIT0_HIGH:
    BSF PORTA, 0
    NOP
    NOP
    NOP
    NOP
    NOP
    BCF PORTA, 0
    

BLUEBIT7:
    BTFSC _SENDLEDBLUE, 7
    GOTO BLUEBIT7_HIGH
    NOP
    BSF PORTA, 0
    NOP
    NOP
    BCF PORTA, 0
    NOP
    GOTO BLUEBIT6
BLUEBIT7_HIGH:
    BSF PORTA, 0
    NOP
    NOP
    NOP
    NOP
    NOP
    BCF PORTA, 0
    
BLUEBIT6:
    BTFSC _SENDLEDBLUE, 6
    GOTO BLUEBIT6_HIGH
    NOP
    BSF PORTA, 0
    NOP
    NOP
    BCF PORTA, 0
    NOP
    GOTO BLUEBIT5
BLUEBIT6_HIGH:
    BSF PORTA, 0
    NOP
    NOP
    NOP
    NOP
    NOP
    BCF PORTA, 0
    
BLUEBIT5:
    BTFSC _SENDLEDBLUE, 5
    GOTO BLUEBIT5_HIGH
    NOP
    BSF PORTA, 0
    NOP
    NOP
    BCF PORTA, 0
    NOP
    GOTO BLUEBIT4
BLUEBIT5_HIGH:
    BSF PORTA, 0
    NOP
    NOP
    NOP
    NOP
    NOP
    BCF PORTA, 0
    
BLUEBIT4:
    BTFSC _SENDLEDBLUE, 4
    GOTO BLUEBIT4_HIGH
    NOP
    BSF PORTA, 0
    NOP
    NOP
    BCF PORTA, 0
    NOP
    GOTO BLUEBIT3
BLUEBIT4_HIGH:
    BSF PORTA, 0
    NOP
    NOP
    NOP
    NOP
    NOP
    BCF PORTA, 0
    
BLUEBIT3:
    BTFSC _SENDLEDBLUE, 3
    GOTO BLUEBIT3_HIGH
    NOP
    BSF PORTA, 0
    NOP
    NOP
    BCF PORTA, 0
    NOP
    GOTO BLUEBIT2
BLUEBIT3_HIGH:
    BSF PORTA, 0
    NOP
    NOP
    NOP
    NOP
    NOP
    BCF PORTA, 0
    
BLUEBIT2:
    BTFSC _SENDLEDBLUE, 2
    GOTO BLUEBIT2_HIGH
    NOP
    BSF PORTA, 0
    NOP
    NOP
    BCF PORTA, 0
    NOP
    GOTO BLUEBIT1
BLUEBIT2_HIGH:
    BSF PORTA, 0
    NOP
    NOP
    NOP
    NOP
    NOP
    BCF PORTA, 0
    
BLUEBIT1:
    BTFSC _SENDLEDBLUE, 1
    GOTO BLUEBIT1_HIGH
    NOP
    BSF PORTA, 0
    NOP
    NOP
    BCF PORTA, 0
    NOP
    GOTO BLUEBIT0
BLUEBIT1_HIGH:
    BSF PORTA, 0
    NOP
    NOP
    NOP
    NOP
    NOP
    BCF PORTA, 0
    
BLUEBIT0:
    BTFSC _SENDLEDBLUE, 0
    GOTO BLUEBIT0_HIGH
    NOP
    BSF PORTA, 0
    NOP
    NOP
    BCF PORTA, 0
    NOP
    GOTO LOOPBACK
BLUEBIT0_HIGH:
    BSF PORTA, 0
    NOP
    NOP
    NOP
    NOP
    NOP
    BCF PORTA, 0
    
LOOPBACK:
    DECFSZ _LEDCOUNTER
    GOTO LEDLOOP
    
    RETURN
	    